#include <behaviors.dtsi>
#include <dt-bindings/zmk/keys.h>

/ {
    keymap {
        compatible = "zmk,keymap";

 }    base_layer {
      display-name = "Base";
      bindings = <
        // ╭─────────┬─────────────┬─────────────┬─────────────┬─────────────╮   ╭──────────┬──────────┬──────────┬──────────┬──────────╮
             &kp Q     &kp W         &kp F         &kp P         &kp B             &kp J      &kp L      &kp U      &kp Y      &kp SQT
        // ├─────────┼─────────────┼─────────────┼─────────────┼─────────────┤   ├──────────┼──────────┼──────────┼──────────┼──────────┤
             &kp A     &kp R         &kp S         &kp T         &kp G             &kp M      &kp N      &kp E      &kp I      &kp O
        // ├─────────┼─────────────┼─────────────┼─────────────┼─────────────┤   ├──────────┼──────────┼──────────┼──────────┼──────────┤
             &kp Z     &kp X         &kp C         &kp D         &kp V             &kp K      &kp H      &kp COMMA  &kp DOT    &kp SLASH
        // ╰─────────┴─────────────┴─────────────┼─────────────┼─────────────┤   ├──────────┼──────────┼──────────┴──────────┴──────────╯
                                                   &kp N1        &kp N2            &kp SPACE  &kp N3
        //                                       ╰─────────────┴─────────────╯   ╰──────────┴──────────╯
      >;
    };;
